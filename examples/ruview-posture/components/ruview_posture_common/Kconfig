## examples/ruview-posture/components/ruview_posture_common/Kconfig
```kconfig
menu "RuView posture common settings"

config RVP_NODE_ID
    int "Logical node identifier"
    range 1 255
    default 1

config RVP_LED_ENABLE
    bool "Enable the WS2812 identity LED"
    default y

config RVP_LED_GPIO
    int "WS2812 identity LED GPIO"
    depends on RVP_LED_ENABLE
    default 48

config RVP_BUILD_ID
    string "Firmware build identifier"
    default "dev-unverified"

config RVP_PROBE_RATE_HZ
    int "Controlled probe frequency"
    range 50 100
    default 100

endmenu
```

## examples/ruview-posture/posture_rx/main/Kconfig.projbuild
```kconfig
menu "RuView posture receiver settings"

config RVP_TX_MAC
    string "Controlled sender Wi-Fi MAC"
    default "28:84:85:92:81:3c"

endmenu
```

## examples/ruview-posture/posture_rx/sdkconfig.defaults
```kconfig
# ESP-IDF 5.5.0, ESP32-S3 controlled receiver node 2.
CONFIG_PARTITION_TABLE_OFFSET=0xa000
CONFIG_ESP_CONSOLE_UART_CUSTOM=y
CONFIG_ESP_CONSOLE_UART_BAUDRATE=921600
CONFIG_ESP_TASK_WDT_TIMEOUT_S=30
CONFIG_ESP_WIFI_DYNAMIC_RX_BUFFER_NUM=128
CONFIG_ESP_WIFI_CSI_ENABLED=y
CONFIG_ESP_WIFI_AMPDU_TX_ENABLED=n
CONFIG_FREERTOS_HZ=1000
CONFIG_RVP_NODE_ID=2
CONFIG_RVP_PROBE_RATE_HZ=100
CONFIG_RVP_LED_ENABLE=y
CONFIG_RVP_LED_GPIO=48
CONFIG_RVP_TX_MAC="28:84:85:92:81:3c"
```
